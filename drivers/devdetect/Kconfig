## drivers/devdetect/Kconfig
```kconfig
#/* <DTS2012030804064 sunwenyong 20120308 begin */
#/* < DTS2011052606009 jiaxianghong 20110527 begin */
#/* <DTS2011032104626 shenjinming 20110321 begin */

#
# I2C devices detect
#

config HUAWEI_HW_DEV_DCT
	bool "HUAWEI DEVICE DETECT"
	depends on HUAWEI_KERNEL = y
	default n
	help
		Say yes if you want i2c device detect driver.
		This is for i2c connected version. If unsure, say N here.

#/* <DTS2011032104626 shenjinming 20110321 end> */
#/* < DTS2011052606009 jiaxianghong 20110527 end */
#/* DTS2012030804064 sunwenyong 20120308 end> */
```

## drivers/nfc/Kconfig
```kconfig
#
# Near Field Communication (NFC) devices
#
#/* < DTS2012030501764 songchuan 20120305 begin */
menuconfig NFC_DEVICES
	bool "Near Field Communication (NFC) devices"
	default n
	---help---
	  You'll have to say Y if your computer contains an NFC device that
	  you want to use under Linux.

	  You can say N here if you don't have any Near Field Communication
	  devices connected to your computer.

if NFC_DEVICES

config PN544_NFC
	tristate "PN544 NFC driver"
	depends on I2C
	select CRC_CCITT
	default n
	---help---
	  Say yes if you want PN544 Near Field Communication driver.
	  This is for i2c connected version. If unsure, say N here.

	  To compile this driver as a module, choose m here. The module will
	  be called pn544.
endif # NFC_DEVICES

# /* < DTS2011042602168 caomingxing 20110426 begin */
# /*< DTS2011011904316 genghua 20110121 begin */
config HUAWEI_NFC_PN544
	default n
	bool "HUAWEI NFC PN544"
	help
		Say yes if you want PN544 Near Field Communication driver.
		This is for i2c connected version. If unsure, say N here.

# /* DTS2011011904316 genghua 20110121 end >*/
# /* DTS2011042602168 caomingxing 20110426 end > */
#/* DTS2012030501764 songchuan 20120305 end > */
```
